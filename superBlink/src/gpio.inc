.equ GPIO_OUTPUT_EN,  0x008
.equ GPIO_OUTPUT_VAL, 0x00C
.equ GPIO_OUTPUT_XOR, 0x040

.equ GPIO_INPUT_EN,   0x004
.equ GPIO_INPUT_VAL,  0x000

.equ OUTPUT,          0x0
.equ INPUT,           0x1
.equ HIGH,            0x0
.equ LOW,             0x1





.equ GPIO_RGB_PINS,   0x680000
.equ GPIO_RED_LED,    0x400000
.equ GPIO_GREEN_LED,  0x080000
.equ GPIO_BLUE_LED,   0x200000

.equ PIN0,            0x010000
.equ PIN1,            0x020000
.equ PIN2,            0x040000
.equ PIN3,            0x080000
.equ PIN4,            0x100000
.equ PIN5,            0x200000
.equ PIN6,            0x400000
.equ PIN7,            0x800000
.equ PIN8,            0x000001
.equ PIN9,            0x000002
.equ PIN10,           0x000004
.equ PIN11,           0x000008
.equ PIN12,           0x000010
.equ PIN13,           0x000020

.equ PIN15,           0x000200
.equ PIN16,           0x000400
.equ PIN17,           0x000800
.equ PIN18,           0x001000
.equ PIN19,           0x002000


.equ PIN11_12,        0x000003




